## config/boards/shields/Alice3D/Kconfig.defconfig
```kconfig
# Copyright (c) 2020 The ZMK Contributors
# SPDX-License-Identifier: MIT

if SHIELD_alice3d_LEFT

config ZMK_KEYBOARD_NAME
    default "alice3d"

config ZMK_SPLIT_ROLE_CENTRAL
    default y

endif

if SHIELD_alice3d_LEFT || SHIELD_alice3d_RIGHT

config ZMK_SPLIT
    default y

endif
```

## config/boards/shields/alice3d/Kconfig.shield
```kconfig
# Copyright (c) 2020 The ZMK Contributors
# SPDX-License-Identifier: MIT

config SHIELD_alice3d_LEFT
    def_bool $(shields_list_contains,alice3d_left)

config SHIELD_alice3d_RIGHT
    def_bool $(shields_list_contains,alice3d_right)
```

## config/boards/shields/atreus3d/Kconfig.defconfig
```kconfig
# Copyright (c) 2020 The ZMK Contributors
# SPDX-License-Identifier: MIT

if SHIELD_atreus3d_LEFT

config ZMK_KEYBOARD_NAME
    default "atreus3d"

config ZMK_SPLIT_ROLE_CENTRAL
    default y

endif

if SHIELD_atreus3d_LEFT || SHIELD_atreus3d_RIGHT

config ZMK_SPLIT
    default y

endif
```

## config/boards/shields/atreus3d/Kconfig.shield
```kconfig
# Copyright (c) 2020 The ZMK Contributors
# SPDX-License-Identifier: MIT

config SHIELD_atreus3d_LEFT
    def_bool $(shields_list_contains,atreus3d_left)

config SHIELD_atreus3d_RIGHT
    def_bool $(shields_list_contains,atreus3d_right)
```
